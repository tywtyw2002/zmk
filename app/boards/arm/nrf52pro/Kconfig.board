## app/boards/arm/nrf52pro/Kconfig.board
```kconfig
# nice!nano board configuration

# Copyright (c) 2020 Pete Johanson
# SPDX-License-Identifier: MIT

config BOARD_NRF54_PRO
    bool "nrf52pro"
    depends on SOC_NRF52840_QIAA
```

## app/boards/arm/nrf52pro/Kconfig.defconfig
```kconfig
# Copyright (c) 2021 The ZMK Contributors
# SPDX-License-Identifier: MIT

if BOARD_NRF54_PRO

config BOARD
    default "nrf52pro"

if USB_DEVICE_STACK

config USB_NRFX
    default y

endif # USB_DEVICE_STACK

config BT_CTLR
    default BT

endif # BOARD_NRF54_PRO
```

## app/boards/arm/nrf52pro_c47/Kconfig.board
```kconfig
# nice!nano board configuration

# Copyright (c) 2020 Pete Johanson
# SPDX-License-Identifier: MIT

config BOARD_NRF54_PRO_C47
    bool "nrf52pro_c47"
    depends on SOC_NRF52840_QIAA
```

## app/boards/arm/nrf52pro_c47/Kconfig.defconfig
```kconfig
# Copyright (c) 2021 The ZMK Contributors
# SPDX-License-Identifier: MIT

if BOARD_NRF54_PRO_C47

config BOARD
    default "nrf52pro_c47"

if USB_DEVICE_STACK

config USB_NRFX
    default y

endif # USB_DEVICE_STACK

config BT_CTLR
    default BT

endif # BOARD_NRF54_PRO_C47
```

## app/boards/shields/c47/Kconfig.defconfig
```kconfig
# Copyright (c) 2020 The ZMK Contributors
# SPDX-License-Identifier: MIT

if SHIELD_C47

config ZMK_KEYBOARD_NAME
    default "CosHiM C47"

endif
```

## app/boards/shields/c47/Kconfig.shield
```kconfig
# Copyright (c) 2020 The ZMK Contributors
# SPDX-License-Identifier: MIT

config SHIELD_C47
    def_bool $(shields_list_contains,c47)
```

## app/boards/shields/c60/Kconfig.defconfig
```kconfig
# Copyright (c) 2020 The ZMK Contributors
# SPDX-License-Identifier: MIT

if SHIELD_C60

config ZMK_KEYBOARD_NAME
    default "CosHiM C60"

endif
```

## app/boards/shields/c60/Kconfig.shield
```kconfig
# Copyright (c) 2020 The ZMK Contributors
# SPDX-License-Identifier: MIT

config SHIELD_C60
    def_bool $(shields_list_contains,c60)
```

## app/boards/shields/corne_esp_wow/Kconfig.shield
```kconfig
# Copyright (c) 2020 Pete Johanson
# SPDX-License-Identifier: MIT

config SHIELD_CORNE_ESP_WOW
    def_bool $(shields_list_contains,corne_esp_wow)
```

## app/dts/bindings/behaviors/zmk,behavior-cfire.yaml
```yaml
# Copyright (c) 2020 The ZMK Contributors
# SPDX-License-Identifier: MIT

description: cFire Behavior

compatible: "zmk,behavior-cfire"

include: one_param.yaml

properties:
  repeat-term-ms:
    type: int
    default: 200
```

## app/dts/bindings/behaviors/zmk,behavior-crepeat.yaml
```yaml
# Copyright (c) 2020 The ZMK Contributors
# SPDX-License-Identifier: MIT

description: cRepeat Behavior

compatible: "zmk,behavior-crepeat"

include: two_param.yaml
```

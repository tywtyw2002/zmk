## app/boards/shields/corne_esp_rl/Kconfig.defconfig
```kconfig
if SHIELD_CORNE_ESP_RL_LEFT

config ZMK_KEYBOARD_NAME
    default "C ESP"

config ZMK_SPLIT_ROLE_CENTRAL
    default y

endif

if SHIELD_CORNE_ESP_RL_LEFT || SHIELD_CORNE_ESP_RL_RIGHT

config ZMK_SPLIT
    default y

endif
```

## app/boards/shields/corne_esp_rl/Kconfig.shield
```kconfig
# Copyright (c) 2020 Pete Johanson
# SPDX-License-Identifier: MIT

config SHIELD_CORNE_ESP_RL_LEFT
    def_bool $(shields_list_contains,corne_esp_rl_left)

config SHIELD_CORNE_ESP_RL_RIGHT
    def_bool $(shields_list_contains,corne_esp_rl_right)

#config SHIELD_CORNE_ESP
#    def_bool $(shields_list_contains,corne_esp)
```

## app/boards/xtensa/c_esp32s3/Kconfig.board
```kconfig
# XIAO ESP32S3 board configuration

# Copyright (c) 2023 Seeed Studio inc.
# SPDX-License-Identifier: Apache-2.0

config BOARD_C_ESP32S3
	bool "CosHiM ESP32S3"
	depends on SOC_SERIES_ESP32S3

choice SOC_PART_NUMBER
	default SOC_ESP32S3_WROOM_N16R2
endchoice
```

## app/boards/xtensa/c_esp32s3/c_esp32s3_defconfig
```kconfig
# SPDX-License-Identifier: Apache-2.0

CONFIG_BOARD_C_ESP32S3=y
CONFIG_SOC_SERIES_ESP32S3=y
CONFIG_MAIN_STACK_SIZE=2048
CONFIG_CONSOLE=y
CONFIG_SERIAL=y
CONFIG_UART_CONSOLE=y
CONFIG_GPIO=y

CONFIG_SETTINGS=y
CONFIG_BT_SETTINGS=y
#CONFIG_NVS=y
#CONFIG_SETTINGS_NVS=y
CONFIG_FCB=y
CONFIG_SETTINGS_FCB=y
CONFIG_FLASH=y
CONFIG_FLASH_PAGE_LAYOUT=y
CONFIG_FLASH_MAP=y

# LOGGING
CONFIG_LOG=y
CONFIG_LOG_DEFAULT_LEVEL=3
CONFIG_ZMK_USB_LOGGING=y

# UF2 NOT WORK
#CONFIG_BUILD_OUTPUT_UF2=y
#CONFIG_BUILD_OUTPUT_UF2_FAMILY_ID="0xc47e5767"
#CONFIG_FLASH_BASE_ADDRESS=0x0
#CONFIG_FLASH_LOAD_OFFSET=0x0
#CONFIG_BUILD_OUTPUT_UF2_USE_FLASH_BASE=y

CONFIG_ZMK_BLE=y
CONFIG_ZMK_USB=n
```

## app/dts/bindings/behaviors/zmk,behavior-hold-layer.yaml
```yaml
# Copyright (c) 2020 The ZMK Contributors
# SPDX-License-Identifier: MIT

description: Hold Layer

compatible: "zmk,behavior-hold-layer"

include: one_param.yaml
```
